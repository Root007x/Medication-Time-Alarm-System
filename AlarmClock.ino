#include <Wire.h>
#include <TimeLib.h>
#include <DS1307RTC.h>
#include <LiquidCrystal_I2C.h>
#include <PCM.h>

tmElements_t tm;

LiquidCrystal_I2C lcd(0x3F, 16, 2);

int notes[] = {262};

const unsigned char sample[] PROGMEM = {
129, 129, 129, 129, 129, 129, 129, 129, 129, 128, 128, 127,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 128, 
};

const char *monthName[12] = {
  "Jan", "Feb", "Mar", "Apr", "May", "Jun",
  "Jul", "Aug", "Sep", "Oct", "Nov", "Dec"
};

int switchAlarmPin = 4;
int switchPin2 = 3;
int switchPin3 = 2;

int switchStateAlarm = 0;
int switchState1 = 0;
int switchState2 = 0;
int switchState3 = 0;

int alarmTimeHour;
int alarmTimeMinutes;

bool isOnAlarm = false;


void setup() {
  Serial.begin(9600);
  //lcd.init();
  lcd.begin();
  while (!Serial) ; // wait for serial
  delay(200);
  lcd.setBacklight(1);
  lcd.setCursor(0, 0);
  lcd.print("starting");
  delay(2000);
  lcd.clear();
  set_time();
  Serial.println("DS1307RTC Read Test");
  Serial.println("-------------------");
  pinMode(4, INPUT);
  pinMode(3, INPUT);
  pinMode(2, INPUT);
  pinMode(5, OUTPUT);
  pinMode(6, OUTPUT);//light
  pinMode(7, OUTPUT);//fan

  digitalWrite(6,0);//light on
  digitalWrite(7,1);
}

void loop() {
  tmElements_t tm;
  
  switchState2 = digitalRead(switchPin2);
  switchState3 = digitalRead(switchPin3);
  switchStateAlarm = digitalRead(switchAlarmPin);

      if(switchStateAlarm == HIGH){
        if(isOnAlarm == false){
          isOnAlarm = true;
        }
        else if(isOnAlarm == true){
          isOnAlarm = false;
        }
      }
      if(alarmTimeMinutes == tm.Minute && alarmTimeHour == tm.Hour){
          if(tm.Second <= 5){
            if(isOnAlarm == true){
              Serial.println("Working Alerm........");

              startPlayback(sample, sizeof(sample));
              startPlayback(sample, sizeof(sample));
              delay(2000);

              digitalWrite(6,1);//light on
              digitalWrite(7,0);//fan off
            }
          }
          else{
            noTone(5);
          }
      }
      else{
        noTone(5);
      }


  
      if(switchState2 == HIGH){
        alarmTimeHour = alarmTimeHour + 1;
        lcd.clear();
        lcd.setCursor(7, 0);
        lcd.print(alarmTimeHour);
        lcd.print(":");
        lcd.print(alarmTimeMinutes);
        Serial.print(alarmTimeHour);
        Serial.print(":");
        Serial.print(alarmTimeMinutes);
        Serial.println();
        
        if(alarmTimeHour == 24){
          alarmTimeHour = 0;
        }
      }
      
      if(switchState3 == HIGH){
        alarmTimeMinutes = alarmTimeMinutes + 1;
        lcd.clear();
        lcd.setCursor(7, 0);
        lcd.print(alarmTimeHour);
        lcd.print(":");
        lcd.print(alarmTimeMinutes);
        Serial.print(alarmTimeHour);
        Serial.print(":");
        Serial.print(alarmTimeMinutes);
        Serial.println();
        
        if(alarmTimeMinutes == 60){
          alarmTimeMinutes = 0;
        }
      }
   

    lcd.clear();
    if (RTC.read(tm)) {
    Serial.print("Ok, Time = ");
    print2digits(tm.Hour);
    Serial.write(':');
    print2digits(tm.Minute);
    Serial.write(':');
    print2digits(tm.Second);
    Serial.print(", Date (D/M/Y) = ");
    Serial.print(tm.Day);
    Serial.write('/');
    Serial.print(tm.Month);
    Serial.write('/');
    Serial.print(tmYearToCalendar(tm.Year));
    Serial.println();
    lcd.setCursor(0, 0);
    lcd.print(tm.Hour);
    lcd.print(":");
    lcd.print(tm.Minute);
    lcd.print(":");
    lcd.print(tm.Second);
    lcd.setCursor(0, 1);
    lcd.print("alarm");
    lcd.setCursor(7, 1);
    lcd.print(alarmTimeHour);
    lcd.print(":");
    lcd.print(alarmTimeMinutes);
    if(isOnAlarm == true){
          lcd.setCursor(13, 1);
          lcd.print("on");
          Serial.println("on");
    }
    if(isOnAlarm == false){
          lcd.setCursor(13, 1);
          lcd.print("off");
          Serial.println("off");
    }
    
    
   } 
   else {
    if (RTC.chipPresent()) {
      Serial.println("The DS1307 is stopped.  Please run the SetTime");
      Serial.println("example to initialize the time and begin running.");
      Serial.println();
    } 
    else {
      Serial.println("DS1307 read error!  Please check the circuitry.");
      Serial.println();
    }
    delay(9000);
  }
  delay(400);
    
  }



void print2digits(int number) {
  if (number >= 0 && number < 10) {
    Serial.write('0');
    lcd.clear();
    lcd.print(tm.Hour);
    lcd.print(":");
    lcd.print(tm.Minute);
    lcd.print(":");
    lcd.print(tm.Second);

  }
  Serial.print(number);
}
